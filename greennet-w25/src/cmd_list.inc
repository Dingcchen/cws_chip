/* common mode */
CMDS(CWS_SERIAL,		"serial")
CMDS(CWS_MAC,			"mac")
/* read mode */
CMDS(CWS_COMMFREQ,		"comm_freq")
CMDS(CWS_SCHEDULE,		"schedule")
/* write mode */
CMDS(CWS_STATUS,		"status")
CMDS(CWS_WARNING,		"warning")
CMDS(CWS_FAULT, 		"fault")
CMDS(CWS_ROLLPOS,		"roll_pos")
/* write immediate mode */
CMDS(CWS_DATAREPLACE,		"date_replace")
CMDS(CWS_DATAINSTALL,		"date_install")
CMDS(CWS_IROLLPOS,		"roll_pos")
CMDS(CWS_ROLLCHANGE,		"roll_change")
CMDS(CWS_CLEARSTATUS,		"clear_status")
CMDS(CWS_CLEARWARNING,		"clear_warning")
CMDS(CWS_CLEARFAULT,		"clear_fault")

/* MAX */
CMDS(CWS_MAX_CMD,		"")

